## app/boards/arm/feather_nrf52840/Kconfig.board
```kconfig
# nice!nano board configuration

# Copyright (c) 2020 Pete Johanson
# SPDX-License-Identifier: MIT

config BOARD_FEATHER_NRF52840
	bool "Adafruit Feather nRF52840 Express for zmk firmware"
	depends on SOC_NRF52840_QIAA
```

## app/boards/arm/feather_nrf52840/Kconfig.defconfig
```kconfig
# Copyright (c) 2021 The ZMK Contributors
# SPDX-License-Identifier: MIT

if BOARD_FEATHER_NRF52840

config BOARD
	default "feather_nrf52840"

config BT_CTLR
	default BT

endif # BOARD_FEATHER_NRF52840
```

## app/boards/seeed/xiao_ble_plus/board.yml
```yaml
board:
  extend: xiao_ble_plus
  variants:
    - name: zmk
      qualifier: nrf52840
```

## app/boards/shields/IVP60/Kconfig.shield
```kconfig
# Copyright (c) 2022 The ZMK Contributors
# SPDX-License-Identifier: MIT

config SHIELD_IVP60_LEFT
   def_bool $(shields_list_contains,IVP60_left)

config SHIELD_IVP60_RIGHT
   def_bool $(shields_list_contains,IVP60_right)
```

## app/boards/shields/moc2_feather/Kconfig.defconfig
```kconfig
# Copyright (c) 2022 The ZMK Contributors
# SPDX-License-Identifier: MIT

if SHIELD_MOC2_FEATHER

config ZMK_KEYBOARD_NAME
    default "moc2_feather"

endif
```

## app/boards/shields/moc2_feather/Kconfig.shield
```kconfig
# Copyright (c) 2022 The ZMK Contributors
# SPDX-License-Identifier: MIT

config SHIELD_MOC2_FEATHER
   def_bool $(shields_list_contains,moc2_feather)
```

## app/boards/shields/moc_adafruit_feather_nrf52840/Kconfig.defconfig
```kconfig
# Copyright (c) 2022 The ZMK Contributors
# SPDX-License-Identifier: MIT

if SHIELD_MOC_ADAFRUIT_FEATHER_NRF52840

config ZMK_KEYBOARD_NAME
    default "moc_adafruit_feather_nrf52840"

endif
```

## app/boards/shields/moc_adafruit_feather_nrf52840/Kconfig.shield
```kconfig
# Copyright (c) 2022 The ZMK Contributors
# SPDX-License-Identifier: MIT

config SHIELD_MOC_ADAFRUIT_FEATHER_NRF52840
   def_bool $(shields_list_contains,moc_adafruit_feather_nrf52840)
```
